## conf/layer.conf
```bitbake
# We have a conf and classes directory, add to BBPATH
BBPATH .= ":${LAYERDIR}"

# We have a recipes directory, add to BBFILES
BBFILES += "${LAYERDIR}/recipes-*/*/*.bb \
     ${LAYERDIR}/recipes-*/*/*.bbappend"

BBFILE_COLLECTIONS += "psicontrol"
BBFILE_PATTERN_psicontrol = "^${LAYERDIR}/"
BBFILE_PRIORITY_psicontrol = "6"
```

## conf/machine/hotraco-hrfocus.conf
```bitbake
#@TYPE: Machine
#@NAME: Hotraco Focus
#@SOC: i.MX6S
#@DESCRIPTION: Machine configuration for Hotraco Focus
#@MAINTAINER: Brecht Neyrinck <brecht.neyrinck@psicontrol.com>

MACHINEOVERRIDES =. "mx6:mx6dl:"

require conf/machine/include/imx-base.inc
require conf/machine/include/tune-cortexa9.inc

SERIAL_CONSOLE = "115200 ttymxc0"

KERNEL_DEVICETREE = "hotraco_hrfocus.dtb"

PREFERRED_PROVIDER_u-boot = "u-boot-psi-hotraco"
PREFERRED_PROVIDER_virtual/bootloader = "u-boot-psi-hotraco"
KERNEL_IMAGETYPE = "uImage"
```

## conf/machine/petersime-ihmi-quad.conf
```bitbake
#@TYPE: Machine
#@NAME: PeterSime iHMI (Quad)
#@SOC: i.MX6Q
#@DESCRIPTION: Machine configuration for PeterSime iHMI (Quad)
#@MAINTAINER: Brecht Neyrinck <brecht.neyrinck@psicontrol.com>

MACHINEOVERRIDES =. "mx6:mx6dl:"

require conf/machine/include/imx-base.inc
require conf/machine/include/tune-cortexa9.inc

SERIAL_CONSOLE = "115200 ttymxc0"

KERNEL_DEVICETREE = "hmi_board_quad.dtb"

PREFERRED_PROVIDER_u-boot = "u-boot-psi"
PREFERRED_PROVIDER_virtual/bootloader = "u-boot-psi"
KERNEL_IMAGETYPE = "uImage"
```

## conf/machine/petersime-ihmi.conf
```bitbake
#@TYPE: Machine
#@NAME: PeterSime iHMI
#@SOC: i.MX6S
#@DESCRIPTION: Machine configuration for PeterSime iHMI
#@MAINTAINER: Brecht Neyrinck <brecht.neyrinck@psicontrol.com>

MACHINEOVERRIDES =. "mx6:mx6dl:"

require conf/machine/include/imx-base.inc
require conf/machine/include/tune-cortexa9.inc

SERIAL_CONSOLE = "115200 ttymxc0"

KERNEL_DEVICETREE = "hmi_board.dtb"

PREFERRED_PROVIDER_u-boot = "u-boot-psi"
PREFERRED_PROVIDER_virtual/bootloader = "u-boot-psi"
KERNEL_IMAGETYPE = "uImage"
```
